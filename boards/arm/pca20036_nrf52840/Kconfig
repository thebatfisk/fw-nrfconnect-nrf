## boards/arm/pca20036_nrf52840/Kconfig
```kconfig
#
# Copyright (c) 2021 Nordic Semiconductor
#
# SPDX-License-Identifier: LicenseRef-BSD-5-Clause-Nordic
#

if BOARD_PCA20036_NRF52840

config BOARD_ENABLE_DCDC
	bool "Enable DCDC mode"
	select SOC_DCDC_NRF52X
	default y

endif # BOARD_PCA20036_NRF52840
```

## boards/arm/pca20036_nrf52840/Kconfig.board
```kconfig
#
# Copyright (c) 2021 Nordic Semiconductor
#
# SPDX-License-Identifier: LicenseRef-BSD-5-Clause-Nordic
#

config BOARD_PCA20036_NRF52840
	bool "PCA20036 NRF52840"
	depends on SOC_NRF52840_QIAA
```

## boards/arm/pca20036_nrf52840/Kconfig.defconfig
```kconfig
#
# Copyright (c) 2021 Nordic Semiconductor
#
# SPDX-License-Identifier: LicenseRef-BSD-5-Clause-Nordic
#

if BOARD_PCA20036_NRF52840

config BOARD
	default "pca20036_nrf52840"

if USB

config USB_NRFX
	default y

config USB_DEVICE_STACK
	default y

endif # USB

config BT_CTLR
	default BT

endif # BOARD_PCA20036_NRF52840
```

## lib/thingy52/orientation_handler/Kconfig
```kconfig
#
# Copyright (c) 2020 Nordic Semiconductor
#
# SPDX-License-Identifier: LicenseRef-BSD-5-Clause-Nordic
#

menuconfig THINGY_ORIENT_HANDLER
	bool "Accelerometer orientation handler Library for Nordic Thingy52 DK"
	select GPIO

if THINGY_ORIENT_HANDLER

module = THINGY_ORIENT_HANDLER
module-str = thingy52 accelerometer orientation handler
source "${ZEPHYR_BASE}/subsys/logging/Kconfig.template.log_config"

endif # DK_LIBRARY
```

## samples/bluetooth/mesh/sensor_server/sample.yaml
```yaml
sample:
  name: Bluetooth Mesh Sensor Server
  description: Bluetooth Mesh Sensor Server sample
tests:
  samples.bluetooth.mesh.sensor_server:
    build_only: true
    build_on_all: true
    platform_whitelist: nrf52dk_nrf52832 nrf52840dk_nrf52840
    tags: bluetooth ci_build
```
