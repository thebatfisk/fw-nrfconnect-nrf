## CMakeLists.txt
```
cmake_minimum_required(VERSION 3.13.1)

find_package(Zephyr REQUIRED HINTS $ENV{ZEPHYR_BASE})
project(NONE)

target_sources(app PRIVATE
	src/main.c
	src/gw_prov_conf.c
	../common/slip.c
	../common/mqtt_serial.c
	../common/uart_simple.c)

target_include_directories(app PRIVATE include
	../common)
```

## sample.yaml
```
sample:
  name: BTM gateway 52840
tests:
  samples.mesh.gateway.nrf52840:
    build_only: true
    build_on_all: true
    platform_whitelist: nrf9160dk_nrf52840
    tags: ci_build
```

## prj.conf
```kconfig
CONFIG_NCS_SAMPLES_DEFAULTS=y

# General configuration
CONFIG_MAIN_STACK_SIZE=4096
CONFIG_SYSTEM_WORKQUEUE_STACK_SIZE=2048
CONFIG_LOG_PROCESS_THREAD_STACK_SIZE=4096
CONFIG_LOG_BUFFER_SIZE=4096
CONFIG_HEAP_MEM_POOL_SIZE=256

CONFIG_FLASH=y
CONFIG_FLASH_MAP=y
CONFIG_FCB=y
CONFIG_NVS=y
CONFIG_SETTINGS=y
CONFIG_HWINFO=y
CONFIG_LOG=y
CONFIG_LOG_PRINTK=y
CONFIG_LOG_BACKEND_SHOW_COLOR=n

CONFIG_DK_LIBRARY=y

# Bluetooth configuration
CONFIG_BT=y
CONFIG_BT_COMPANY_ID=0x0059
CONFIG_BT_TINYCRYPT_ECC=y
#CONFIG_BT_DEBUG_LOG=y
CONFIG_BT_OBSERVER=y
CONFIG_BT_BROADCASTER=y

# Bluetooth Mesh configuration
CONFIG_BT_MESH=y
CONFIG_BT_MESH_SUBNET_COUNT=1
CONFIG_BT_MESH_APP_KEY_COUNT=1
CONFIG_BT_MESH_RX_SEG_MAX=15
CONFIG_BT_MESH_ADV_BUF_COUNT=10
CONFIG_BT_MESH_TX_SEG_MSG_COUNT=10
CONFIG_BT_MESH_MODEL_GROUP_COUNT=2
CONFIG_BT_MESH_LABEL_COUNT=0
CONFIG_BT_MESH_CFG_CLI=y
CONFIG_BT_MESH_HEALTH_CLI=y

CONFIG_BT_MESH_PROVISIONER=y
CONFIG_BT_MESH_CDB=y
CONFIG_BT_MESH_CDB_NODE_COUNT=3
CONFIG_BT_MESH_CDB_SUBNET_COUNT=3
CONFIG_BT_MESH_CDB_APP_KEY_COUNT=3

CONFIG_BT_SETTINGS=y
CONFIG_FLASH=y
CONFIG_FLASH_PAGE_LAYOUT=y
CONFIG_FLASH_MAP=y
CONFIG_NVS=y
CONFIG_SETTINGS=y
CONFIG_BT_MESH_RPL_STORE_TIMEOUT=600

#CONFIG_BT_MESH_DEBUG=y
#CONFIG_BT_MESH_DEBUG_SETTINGS=y
#CONFIG_BT_MESH_DEBUG_NET=y
#CONFIG_BT_MESH_DEBUG_MODEL=y
#CONFIG_BT_MESH_DEBUG_TRANS=y
#CONFIG_BT_MESH_DEBUG_ACCESS=y

#CONFIG_BT_MESH_LOW_POWER=y
#CONFIG_BT_MESH_DEBUG_PROV=y
#CONFIG_BT_MESH_DEBUG_LOW_POWER=y
#CONFIG_BT_MESH_DEBUG_BEACON=y
#CONFIG_BT_MESH_DEBUG_CRYPTO=y
#CONFIG_BT_MESH_DEBUG_ADV=y

# Bluetooth Mesh models
CONFIG_BT_MESH_ONOFF_CLI=y
CONFIG_BT_MESH_ONOFF_SRV=y
CONFIG_BT_MESH_LVL_CLI=y

# UART
CONFIG_SERIAL=y
CONFIG_UART_ASYNC_API=y
CONFIG_UART_INTERRUPT_DRIVEN=y
CONFIG_NET_BUF=y
CONFIG_CONSOLE=y
CONFIG_STDOUT_CONSOLE=y
CONFIG_UART_CONSOLE=y
CONFIG_GPIO=y

# JSON
# CONFIG_JSON_LIBRARY=y
CONFIG_HEAP_MEM_POOL_SIZE=2048
CONFIG_MAIN_STACK_SIZE=8192
CONFIG_NEWLIB_LIBC_FLOAT_PRINTF=y
CONFIG_NEWLIB_LIBC=y
CONFIG_CJSON_LIB=y

# Connect the MCU interface pins to the nRF9160
# We will instantiate UART1 on these pins
CONFIG_BOARD_NRF9160DK_INTERFACE0_MCU=y
CONFIG_BOARD_NRF9160DK_INTERFACE1_MCU=y

# Enable reset pin on P1.02
CONFIG_BOARD_NRF9160DK_NRF52840_RESET=y
CONFIG_BOARD_NRF9160DK_NRF52840_RESET_P1_02=y
```

## nrf9160dk_nrf52840.overlay
```dts
&uart1 {
	compatible = "nordic,nrf-uarte";
	current-speed = <460800>;
	status = "okay";
	hw-flow-control;
	tx-pin = <17>;
	rx-pin = <20>;
	rts-pin = <15>;
	cts-pin = <22>;
};
```

## src/main.c
```c
#include <zephyr.h>
#include <stdio.h>
#include <string.h>
#include <stdlib.h>
#include "uart_simple.h"
#include "mqtt_serial.h"
#include "prov_conf_common.h"
#include "gw_prov_conf.h"

#include <bluetooth/bluetooth.h>
#include <bluetooth/mesh.h>
#include <bluetooth/mesh/models.h>
#include <dk_buttons_and_leds.h>

#include <random/rand32.h>
#include <cJSON.h>
#include <cJSON_os.h>

#define ON_STRING "ON"
#define OFF_STRING "OFF"
#define SET_IDENTIFIER "btm/set/"
#define TOPIC_MAX_SIZE 64
#define SERIAL_BUF_SIZE 256
#define HEX_RADIX 16
#define HASS_DISCOVERY_REQUEST 0

void mqtt_rx_callback(struct net_buf *get_buf);
void prov_conf_rx_callback(struct net_buf *get_buf);

struct room_info rooms[] = {
	[0] = { .name = "Living_Room", .group_addr = BASE_GROUP_ADDR },
	[1] = { .name = "Kitchen", .group_addr = BASE_GROUP_ADDR + 1 },
	[2] = { .name = "Bedroom", .group_addr = BASE_GROUP_ADDR + 2 },
	[3] = { .name = "Bathroom", .group_addr = BASE_GROUP_ADDR + 3 },
	[4] = { .name = "Hallway", .group_addr = BASE_GROUP_ADDR + 4 }
};

struct light_struct {
	bool on_off;
	uint8_t brightness;
};

static struct uart_channel_ctx mqtt_serial_chan = {
	.channel_id = 1,
	.rx_cb = mqtt_rx_callback,
};

static struct uart_channel_ctx prov_conf_serial_chan = {
	.channel_id = 2,
	.rx_cb = prov_conf_rx_callback,
};

static int json_add_str(cJSON *parent, const char *str, const char *item)
{
	cJSON *json_str = cJSON_CreateString(item);
	if (json_str == NULL) {
		return -ENOMEM;
	}

	cJSON_AddItemToObject(parent, str, json_str);
	return 0;
}

static int json_add_bool(cJSON *parent, const char *str, bool boolean)
{
	cJSON *json_bool = cJSON_CreateBool(boolean);
	if (json_bool == NULL) {
		return -ENOMEM;
	}

	cJSON_AddItemToObject(parent, str, json_bool);
	return 0;
}

static int json_add_number(cJSON *parent, const char *str, double item)
{
	cJSON *json_num = cJSON_CreateNumber(item);
	if (json_num == NULL) {
		return -ENOMEM;
	}

	cJSON_AddItemToObject(parent, str, json_num);
	return 0;
}

static void mqtt_serial_send(uint8_t *topic, uint16_t topic_len, uint8_t *data,
			     uint16_t data_len)
{
	uint8_t outgoing_buf[SERIAL_BUF_SIZE];
	uint16_t outgoing_msg_len;
	struct mqtt_publish_param param = {
		.message.topic.topic.utf8 = topic,
		.message.topic.topic.size = topic_len,
		.message.payload.data = data,
		.message.payload.len = data_len,
		.message.topic.qos = 0,
		.message_id = k_uptime_get(),
		.dup_flag = 0,
		.retain_flag = 0,
	};

	int err = mqtt_serial_msg_encode(
		&param, outgoing_buf, sizeof(outgoing_buf), &outgoing_msg_len);

	if (!err) {
		uart_simple_send(&mqtt_serial_chan, outgoing_buf,
				 outgoing_msg_len);
	}
}

static void mqtt_state_reply_send(uint16_t model_id, uint16_t addr,
				  uint8_t *data, uint16_t data_len)
{
	char topic[TOPIC_MAX_SIZE];
	int topic_len = sprintf(topic, "btm/state/%04x%04x", model_id, addr);

	mqtt_serial_send(topic, topic_len, data, data_len);
}

static void discovery_light_create(uint16_t model_id, uint16_t addr, char *name)
{
	char topic[TOPIC_MAX_SIZE], cmd[TOPIC_MAX_SIZE], state[TOPIC_MAX_SIZE];
	int topic_len = sprintf(topic, "homeassistant/light/%s/config", name);

	sprintf(cmd, "btm/set/%04x%04x", model_id, addr);
	sprintf(state, "btm/state/%04x%04x", model_id, addr);

	cJSON *json_struct = cJSON_CreateObject();
	if (json_struct == NULL) {
		printk("No memory to create JSON object\n");
		return;
	}

	json_add_str(json_struct, "name", name);
	json_add_str(json_struct, "unique_id", name);
	json_add_str(json_struct, "cmd_t", cmd);
	json_add_str(json_struct, "stat_t", state);
	json_add_str(json_struct, "schema", "json");
	json_add_bool(json_struct, "brightness", true);

	char *json_packed = cJSON_Print(json_struct);
	if (json_packed == NULL) {
		printk("No memory to print JSON output\n");
		return;
	}

	cJSON_Delete(json_struct);
	mqtt_serial_send(topic, topic_len, json_packed, strlen(json_packed));
	cJSON_FreeString(json_packed);
}

static void discovery_binary_sensor_create(uint16_t model_id, uint16_t addr,
					   char *name)
{
	char topic[TOPIC_MAX_SIZE], state[TOPIC_MAX_SIZE];
	int topic_len =
		sprintf(topic, "homeassistant/binary_sensor/%s/config", name);

	sprintf(state, "btm/state/%04x%04x", model_id, addr);

	cJSON *json_struct = cJSON_CreateObject();
	if (json_struct == NULL) {
		printk("No memory to create JSON object\n");
		return;
	}

	json_add_str(json_struct, "name", name);
	json_add_str(json_struct, "unique_id", name);
	json_add_str(json_struct, "stat_t", state);
	json_add_str(json_struct, "value_template", "{{ value_json.state}}");

	char *json_packed = cJSON_Print(json_struct);
	if (json_packed == NULL) {
		printk("No memory to print JSON output\n");
		return;
	}
	cJSON_Delete(json_struct);

	mqtt_serial_send(topic, topic_len, json_packed, strlen(json_packed));
	cJSON_FreeString(json_packed);
}

void light_packet_decode(uint8_t *data, uint16_t data_len,
			 struct light_struct *struct_out)
{
	struct cJSON *root_obj, *on_off, *brightness;

	root_obj = cJSON_Parse(data);
	if (root_obj == NULL) {
		printk("Could not parse properties object\n");
		return;
	}

	on_off = cJSON_GetObjectItem(root_obj, "state");
	brightness = cJSON_GetObjectItem(root_obj, "brightness");

	if (!strcmp(ON_STRING, on_off->valuestring)) {
		struct_out->on_off = true;
		struct_out->brightness =
			brightness ? brightness->valueint : UINT8_MAX;
	} else {
		struct_out->on_off = false;
		struct_out->brightness = 0;
	}
	cJSON_Delete(root_obj);
}

static void gen_onoff_cli_status_cb(struct bt_mesh_onoff_cli *cli,
				    struct bt_mesh_msg_ctx *ctx,
				    const struct bt_mesh_onoff_status *status)
{
	cJSON *json_struct = cJSON_CreateObject();

	if (json_struct == NULL) {
		printk("No memory to create JSON object\n");
		return;
	}

	json_add_str(json_struct, "state",
		     status->target_on_off ? ON_STRING : OFF_STRING);
	json_add_number(json_struct, "brightness",
			status->target_on_off ? UINT8_MAX : 0);

	char *json_packed = cJSON_Print(json_struct);

	if (json_packed == NULL) {
		printk("No memory to print JSON output\n");
		return;
	}
	printk("recv_dst: %x\n", ctx->recv_dst);
	mqtt_state_reply_send(BT_MESH_MODEL_ID_GEN_ONOFF_SRV, ctx->addr,
			      json_packed, strlen(json_packed));
	cJSON_Delete(json_struct);
	cJSON_FreeString(json_packed);
}

static void gen_lvl_status_cb(struct bt_mesh_lvl_cli *cli,
			      struct bt_mesh_msg_ctx *ctx,
			      const struct bt_mesh_lvl_status *status)
{
	cJSON *json_struct = cJSON_CreateObject();

	if (json_struct == NULL) {
		printk("No memory to create JSON object\n");
		return;
	}

	json_add_str(json_struct, "state",
		     (status->target != INT16_MIN) ? ON_STRING : OFF_STRING);
	json_add_number(json_struct, "brightness",
			(((UINT16_MAX / 2) + status->target) * UINT8_MAX) /
				UINT16_MAX);

	char *json_packed = cJSON_Print(json_struct);

	if (json_packed == NULL) {
		printk("No memory to print JSON output\n");
		return;
	}

	mqtt_state_reply_send(BT_MESH_MODEL_ID_GEN_LEVEL_SRV, ctx->addr,
			      json_packed, strlen(json_packed));
	cJSON_FreeString(json_packed);
	cJSON_Delete(json_struct);
}

static void gen_onoff_srv_set_cb(struct bt_mesh_onoff_srv *srv,
				 struct bt_mesh_msg_ctx *ctx,
				 const struct bt_mesh_onoff_set *set,
				 struct bt_mesh_onoff_status *rsp)
{
	cJSON *json_struct = cJSON_CreateObject();

	if (json_struct == NULL) {
		printk("No memory to create JSON object\n");
		return;
	}

	json_add_str(json_struct, "state",
		     set->on_off ? ON_STRING : OFF_STRING);

	char *json_packed = cJSON_Print(json_struct);

	if (json_packed == NULL) {
		printk("No memory to print JSON output\n");
		return;
	}

	mqtt_state_reply_send(BT_MESH_MODEL_ID_GEN_ONOFF_CLI, ctx->addr,
			      json_packed, strlen(json_packed));
	cJSON_Delete(json_struct);
	cJSON_FreeString(json_packed);

	rsp->present_on_off = set->on_off;
	rsp->target_on_off = set->on_off;
}

static void gen_onoff_srv_get_cb(struct bt_mesh_onoff_srv *srv,
				 struct bt_mesh_msg_ctx *ctx,
				 struct bt_mesh_onoff_status *rsp)
{
}

struct bt_mesh_onoff_srv_handlers gen_on_off_cb = {
	.set = gen_onoff_srv_set_cb,
	.get = gen_onoff_srv_get_cb,
};

struct bt_mesh_onoff_cli gen_onoff_cli =
	BT_MESH_ONOFF_CLI_INIT(gen_onoff_cli_status_cb);
struct bt_mesh_onoff_srv gen_onoff_srv = BT_MESH_ONOFF_SRV_INIT(&gen_on_off_cb);
struct bt_mesh_lvl_cli gen_lvl_cli = BT_MESH_LVL_CLI_INIT(gen_lvl_status_cb);

static struct bt_mesh_model gateway_models[] = {
	BT_MESH_MODEL_LVL_CLI(&gen_lvl_cli),
	BT_MESH_MODEL_ONOFF_CLI(&gen_onoff_cli),
	BT_MESH_MODEL_ONOFF_SRV(&gen_onoff_srv),
};

static struct bt_mesh_cfg_srv cfg_srv = {
	.relay = BT_MESH_RELAY_ENABLED,
	.beacon = BT_MESH_BEACON_DISABLED,
	.frnd = BT_MESH_FRIEND_NOT_SUPPORTED,
	.default_ttl = 7,

	/* 3 transmissions with 20ms interval */
	.net_transmit = BT_MESH_TRANSMIT(2, 20),
	.relay_retransmit = BT_MESH_TRANSMIT(3, 20),
};

static struct bt_mesh_cfg_cli cfg_cli = {};

static void health_current_status(struct bt_mesh_health_cli *cli, uint16_t addr,
				  uint8_t test_id, uint16_t cid,
				  uint8_t *faults, size_t fault_count)
{
	size_t i;

	printk("Health Current Status from 0x%04x\n", addr);

	if (!fault_count) {
		printk("Health Test ID 0x%02x Company ID 0x%04x: no faults\n",
		       test_id, cid);
		return;
	}

	printk("Health Test ID 0x%02x Company ID 0x%04x Fault Count %zu:\n",
	       test_id, cid, fault_count);

	for (i = 0; i < fault_count; i++) {
		printk("\t0x%02x\n", faults[i]);
	}
}

static struct bt_mesh_health_cli health_cli = {
	.current_status = health_current_status,
};

static struct bt_mesh_model root_models[] = {
	BT_MESH_MODEL_CFG_SRV(&cfg_srv),
	BT_MESH_MODEL_CFG_CLI(&cfg_cli),
	BT_MESH_MODEL_HEALTH_CLI(&health_cli),
};

static struct bt_mesh_elem elements[] = {
	BT_MESH_ELEM(0, root_models, BT_MESH_MODEL_NONE),
	BT_MESH_ELEM(1, gateway_models, BT_MESH_MODEL_NONE),
};

static const struct bt_mesh_comp comp = {
	.cid = CONFIG_BT_COMPANY_ID,
	.elem = elements,
	.elem_count = ARRAY_SIZE(elements),
};

static void add_element_to_hass(uint16_t model_id, uint16_t addr, uint16_t group_addr, uint16_t room_num, const char *name)
{
	char merge_string[15];
	char name_string[30];

	strcpy(name_string, name);

	if (model_id == BT_MESH_MODEL_ID_GEN_ONOFF_SRV) {
		if (!rooms[room_num].light_group_added_to_hass) {
			discovery_light_create(BT_MESH_MODEL_ID_GEN_ONOFF_SRV, group_addr, name);
			rooms[room_num].light_group_added_to_hass = true;
		}

		sprintf(merge_string, "_light_%d", rooms[room_num].light_count);
		rooms[room_num].light_count++;
		strcat(name_string, merge_string);
		discovery_light_create(BT_MESH_MODEL_ID_GEN_ONOFF_SRV, addr, name_string);
	} else if (model_id == BT_MESH_MODEL_ID_GEN_ONOFF_CLI) {
		if (!rooms[room_num].switch_group_added_to_hass) {
			discovery_binary_sensor_create(BT_MESH_MODEL_ID_GEN_ONOFF_CLI, group_addr, name);
			rooms[room_num].switch_group_added_to_hass = true;
		}

		sprintf(merge_string, "_switch_%d", rooms[room_num].switch_count);
		rooms[room_num].switch_count++;
		strcat(name_string, merge_string);
		discovery_binary_sensor_create(BT_MESH_MODEL_ID_GEN_ONOFF_CLI, addr, name_string);
	}
}

void mqtt_msg_handler(uint16_t model_id, uint16_t addr, uint8_t *data,
		      uint16_t data_len)
{
	switch (model_id) {
	case HASS_DISCOVERY_REQUEST:
		/* Dummy discovery */
		break;

	case BT_MESH_MODEL_ID_GEN_ONOFF_SRV: {
		struct light_struct recived;
		light_packet_decode(data, data_len, &recived);

		struct bt_mesh_onoff_set set_msg = {
			.on_off = recived.on_off,
			.transition = NULL,
		};

		struct bt_mesh_msg_ctx ctx = {
			.app_idx = gen_lvl_cli.pub.key,
			.addr = addr,
			.send_rel = gen_lvl_cli.pub.send_rel,
			.send_ttl = gen_lvl_cli.pub.ttl,
		};

		bt_mesh_onoff_cli_set(&gen_onoff_cli, &ctx, &set_msg, NULL);
		break;
	}

	case BT_MESH_MODEL_ID_GEN_LEVEL_SRV: {
		struct light_struct recived;
		light_packet_decode(data, data_len, &recived);

		struct bt_mesh_lvl_set set_msg = {
			.new_transaction = true,
			.transition = NULL,
			.lvl = recived.on_off ? (((int8_t)(recived.brightness -
							   INT8_MAX) *
						  INT16_MAX) /
						 INT8_MAX) :
						INT16_MIN,
		};

		struct bt_mesh_msg_ctx ctx = {
			.app_idx = gen_lvl_cli.pub.key,
			.addr = addr,
			.send_rel = gen_lvl_cli.pub.send_rel,
			.send_ttl = gen_lvl_cli.pub.ttl,
		};

		bt_mesh_lvl_cli_set(&gen_lvl_cli, &ctx, &set_msg, NULL);
		break;
	}
	default:
		break;
	}
}

void mqtt_rx_callback(struct net_buf *get_buf)
{
	char model_id_str[] = "0000";
	char addr_str[] = "0000";

	struct mqtt_publish_param param;
	mqtt_serial_msg_decode(get_buf, &param);

	if (strncmp(SET_IDENTIFIER, param.message.topic.topic.utf8,
		    strlen(SET_IDENTIFIER))) {
		/* Not a set message */
		return;
	}
	strncpy(model_id_str,
		param.message.topic.topic.utf8 + strlen(SET_IDENTIFIER),
		strlen(model_id_str));
	strncpy(addr_str,
		param.message.topic.topic.utf8 + strlen(SET_IDENTIFIER) +
			strlen(model_id_str),
		strlen(addr_str));

	uint16_t model_id = strtol(model_id_str, NULL, HEX_RADIX);
	uint16_t addr = strtol(addr_str, NULL, HEX_RADIX);

	mqtt_msg_handler(model_id, addr, param.message.payload.data,
			 param.message.payload.len);
}

void prov_conf_rx_callback(struct net_buf *get_buf)
{
	NET_BUF_SIMPLE_DEFINE(serial_net_buf, 20);
	uint8_t serial_message[20];
	uint8_t opcode = net_buf_pull_u8(get_buf);
	static struct model_info mod_inf;
	int err;

	printk("Serial opcode: %d\n", opcode);

	if (opcode == oc_prov_link_active) {
		serial_message[0] = oc_prov_link_active;
		serial_message[1] = (uint8_t)prov_link_active();
		uart_simple_send(&prov_conf_serial_chan, serial_message, 2);
	} else if (opcode == oc_unprov_dev_num) {
		serial_message[0] = oc_unprov_dev_num;
		serial_message[1] = get_unprov_dev_num();
		uart_simple_send(&prov_conf_serial_chan, serial_message, 2);
	} else if (opcode == oc_get_model_info) {
		mod_inf.srv_count = 0;
		mod_inf.cli_count = 0;
		get_model_info(&mod_inf);

		printk("Server count: %d - Client cout: %d\n", mod_inf.srv_count, mod_inf.cli_count);

		net_buf_simple_reset(&serial_net_buf);
		net_buf_simple_add_u8(&serial_net_buf, oc_get_model_info);
		net_buf_simple_add_le16(&serial_net_buf, mod_inf.srv_count);
		net_buf_simple_add_le16(&serial_net_buf, mod_inf.cli_count);
		uart_simple_send(&prov_conf_serial_chan, serial_net_buf.data, serial_net_buf.len);
	} else if (opcode == oc_blink_device) {
		uint8_t device = net_buf_pull_u8(get_buf);
		blink_device(device);
	} else if (opcode == oc_provision_device) {
		uint8_t dev_num = net_buf_pull_u8(get_buf);

		if (dev_num == 0xff) {
			uint8_t uuid[16];
			memcpy(uuid, get_buf->data, 16);
			provision_device(dev_num, uuid);
		} else {
			provision_device(dev_num, NULL);
		}

		serial_message[0] = oc_device_added;
		uart_simple_send(&prov_conf_serial_chan, serial_message, 1);
	} else if (opcode == oc_configure_server) {
		uint8_t elem_num = net_buf_pull_u8(get_buf);
		uint16_t group_addr = net_buf_pull_be16(get_buf);
		printk("Server group address: 0x%04x\n", group_addr);
		err = configure_server(elem_num, group_addr);

		if (err) {
			printk("Error configuring server\n");
		} else {
			for (int i = 0; i < 5; i++) {
				if (rooms[i].group_addr == group_addr) {
					add_element_to_hass(BT_MESH_MODEL_ID_GEN_ONOFF_SRV, (get_added_node_addr() + elem_num), group_addr, i, rooms[i].name);
					break;
				}
			}
		}
	} else if (opcode == oc_configure_client) {
		uint8_t elem_num = net_buf_pull_u8(get_buf);
		uint16_t group_addr = net_buf_pull_be16(get_buf);
		printk("Client group address: 0x%04x\n", group_addr);
		err = configure_client(elem_num, group_addr);

		if (err) {
			printk("Error configuring client\n");
		} else {
			for (int i = 0; i < 5; i++) {
				if (rooms[i].group_addr == group_addr) {
					add_element_to_hass(BT_MESH_MODEL_ID_GEN_ONOFF_CLI, (get_added_node_addr() + elem_num), group_addr, i, rooms[i].name);
					break;
				}
			}
		}
	}
}

void main(void)
{
	int err;

	printk("MQTT bridge nrf52840 started\n");

	cJSON_Init();
	uart_simple_init(NULL);
	uart_simple_channel_create(&mqtt_serial_chan);
	uart_simple_channel_create(&prov_conf_serial_chan);

	set_comp_data(comp);

	err = bt_enable(bt_ready);
	if (err) {
		printk("Bluetooth init failed (err %d)\n", err);
	}
}
```

## include/gw_prov_conf.h
```c
#ifndef GW_PROVISIONING_H__
#define GW_PROVISIONING_H__

#include <bluetooth/bluetooth.h>
#include <bluetooth/mesh.h>
#include "prov_conf_common.h"

#ifdef __cplusplus
extern "C" {
#endif

#ifndef BT_MESH_PROV_CONF_BGR
#define BT_MESH_PROV_CONF_BGR
#define BASE_GROUP_ADDR 0xc000
#endif /* BT_MESH_PROV_CONF_BGR */

#define MAX_UNPROV_DEVICES 30
#define UNPROV_BEAC_TIMEOUT 30

struct unprov_device {
	uint8_t uuid[16];
	uint16_t addr;
	uint16_t time;
};

struct unprov_devices {
	uint8_t number;
	struct unprov_device dev[MAX_UNPROV_DEVICES];
};

void set_comp_data(const struct bt_mesh_comp comp_data);

void bt_ready(int err);

int provision_device(uint8_t dev_num, const uint8_t *uuid);

int get_model_info(struct model_info *mod_inf);

int configure_server(uint8_t elem_num, uint16_t group_addr);

int configure_client(uint8_t elem_num, uint16_t group_addr);

void blink_device(uint8_t dev_num);

uint8_t get_unprov_dev_num(void);

bool prov_link_active(void);

uint16_t get_added_node_addr(void);

#ifdef __cplusplus
}
#endif

#endif /* GW_PROVISIONING_H__ */
```

## src/gw_prov_conf.c
```c
/*
 * Copyright (c) 2020 Nordic Semiconductor ASA
 *
 * SPDX-License-Identifier: LicenseRef-BSD-5-Clause-Nordic
 */

#include <bluetooth/bluetooth.h>
#include <bluetooth/mesh.h>
#include <settings/settings.h>
#include "gw_prov_conf.h"
#include "prov_conf_common.h"

static struct unprov_devices unprov_devs;

static const uint16_t net_idx;
static const uint16_t app_idx;
static struct bt_mesh_comp gw_comp_data;
static uint16_t self_addr = 1, added_node_addr;
static const uint8_t dev_uuid[16] = { 0xdd, 0xdd };

K_SEM_DEFINE(sem_node_added, 0, 1);

static void setup_cdb(void)
{
	struct bt_mesh_cdb_app_key *key;

	key = bt_mesh_cdb_app_key_alloc(net_idx, app_idx);
	if (key == NULL) {
		printk("Failed to allocate app-key 0x%04x\n", app_idx);
		return;
	}

	bt_rand(key->keys[0].app_key, 16);

	if (IS_ENABLED(CONFIG_BT_SETTINGS)) {
		bt_mesh_cdb_app_key_store(key);
	}
}

static void configure_self(struct bt_mesh_cdb_node *self)
{
	struct bt_mesh_cdb_app_key *key;
	int err;

	printk("Configuring self...\n");

	key = bt_mesh_cdb_app_key_get(app_idx);
	if (key == NULL) {
		printk("No app-key 0x%04x\n", app_idx);
		return;
	}

	/* Add Application Key */
	err = bt_mesh_cfg_app_key_add(self->net_idx, self->addr, self->net_idx,
				      app_idx, key->keys[0].app_key, NULL);
	if (err < 0) {
		printk("Failed to add app-key (err %d)\n", err);
		return;
	}

	err = bt_mesh_cfg_mod_app_bind(self->net_idx, self->addr, self->addr,
				       app_idx, BT_MESH_MODEL_ID_HEALTH_CLI,
				       NULL);
	if (err < 0) {
		printk("Failed to bind health client app-key (err %d)\n", err);
		return;
	}

	err = bt_mesh_cfg_mod_app_bind(self->net_idx, self->addr, (self->addr + 1),
				       app_idx, BT_MESH_MODEL_ID_GEN_LEVEL_CLI,
				       NULL);
	if (err < 0) {
		printk("Failed to bind level client app-key (err %d)\n", err);
		return;
	}

	err = bt_mesh_cfg_mod_app_bind(self->net_idx, self->addr, (self->addr + 1),
				       app_idx, BT_MESH_MODEL_ID_GEN_ONOFF_CLI,
				       NULL);
	if (err < 0) {
		printk("Failed to bind onoff client app-key (err %d)\n", err);
		return;
	}

	err = bt_mesh_cfg_mod_app_bind(self->net_idx, self->addr, (self->addr + 1),
				       app_idx, BT_MESH_MODEL_ID_GEN_ONOFF_SRV,
				       NULL);
	if (err < 0) {
		printk("Failed to bind onoff server app-key (err %d)\n", err);
		return;
	}

	// TODO: bt_mesh_cfg_mod_sub_add() and bt_mesh_cfg_mod_pub_set()

	atomic_set_bit(self->flags, BT_MESH_CDB_NODE_CONFIGURED);

	if (IS_ENABLED(CONFIG_BT_SETTINGS)) {
		bt_mesh_cdb_node_store(self);
	}

	printk("Configuration complete\n");
}

static void configure_node(struct bt_mesh_cdb_node *node)
{
	struct bt_mesh_cdb_app_key *key;
	struct bt_mesh_cfg_mod_pub pub;
	uint8_t status;
	int err;

	printk("Configuring node 0x%04x...\n", node->addr);

	key = bt_mesh_cdb_app_key_get(app_idx);
	if (key == NULL) {
		printk("No app-key 0x%04x\n", app_idx);
		return;
	}

	/* Add Application Key */
	err = bt_mesh_cfg_app_key_add(net_idx, node->addr, net_idx, app_idx,
				      key->keys[0].app_key, NULL);
	if (err < 0) {
		printk("Failed to add app-key (err %d)\n", err);
		return;
	}

	/* Bind to Health model */
	err = bt_mesh_cfg_mod_app_bind(net_idx, node->addr, node->addr, app_idx,
				       BT_MESH_MODEL_ID_HEALTH_SRV, NULL);
	if (err < 0) {
		printk("Failed to bind app-key (err %d)\n", err);
		return;
	}

	pub.addr = 1;
	pub.app_idx = key->app_idx;
	pub.cred_flag = false;
	pub.ttl = 7;
	pub.period = BT_MESH_PUB_PERIOD_10SEC(1);
	pub.transmit = 0;

	err = bt_mesh_cfg_mod_pub_set(net_idx, node->addr, node->addr,
				      BT_MESH_MODEL_ID_HEALTH_SRV, &pub,
				      &status);
	if (err < 0) {
		printk("mod_pub_set %d, %d\n", err, status);
		return;
	}

	atomic_set_bit(node->flags, BT_MESH_CDB_NODE_CONFIGURED);

	if (IS_ENABLED(CONFIG_BT_SETTINGS)) {
		bt_mesh_cdb_node_store(node);
	}

	printk("Configuration complete\n");
}

static void unprovisioned_beacon(uint8_t uuid[16],
				 bt_mesh_prov_oob_info_t oob_info,
				 uint32_t *uri_hash)
{
	bool dev_in_list = false;

	if (unprov_devs.number == 0) {
		memcpy(unprov_devs.dev[0].uuid, uuid, 16);
		unprov_devs.dev[0].time = 0;
		unprov_devs.number++;
		printk("%d unprovisioned node\n", unprov_devs.number);
	} else if (unprov_devs.number < MAX_UNPROV_DEVICES) {
		for (int i = 0; i < unprov_devs.number; i++) {
			if (!memcmp(unprov_devs.dev[i].uuid, uuid, 16)) {
				dev_in_list = true;
				unprov_devs.dev[i].time = 0;
			}
		}

		if (!dev_in_list) {
			memcpy(unprov_devs.dev[unprov_devs.number].uuid, uuid, 16);
			unprov_devs.dev[unprov_devs.number].time = 0;
			unprov_devs.number++;
			printk("%d unprovisioned nodes\n", unprov_devs.number);
		}
	}

	// char uuid_hex_str[32 + 1];
	// bin2hex(uuid, 16, uuid_hex_str, sizeof(uuid_hex_str));
	// printk("Unprov beacon: %s - %X\n", uuid_hex_str, oob_info);
}

static void node_added(uint16_t net_idx, uint8_t uuid[16], uint16_t addr,
		       uint8_t num_elem)
{
	added_node_addr = addr;

	for (int i = 0; i < unprov_devs.number; i++) {
		if (!memcmp(unprov_devs.dev[i].uuid, uuid, 16)) {
			for (int j = i; j < unprov_devs.number; j++) {
				unprov_devs.dev[j] = unprov_devs.dev[j + 1];
			}

			unprov_devs.number--;

			break;
		}
	}

	k_sem_give(&sem_node_added);
}

static const struct bt_mesh_prov prov = {
	.uuid = dev_uuid,
	.unprovisioned_beacon = unprovisioned_beacon,
	.node_added = node_added,
};

static uint8_t check_unconfigured(struct bt_mesh_cdb_node *node, void *data)
{
	if (!atomic_test_bit(node->flags, BT_MESH_CDB_NODE_CONFIGURED)) {
		if (node->addr == self_addr) {
			configure_self(node);
		} else {
			configure_node(node);
		}
	}

	return BT_MESH_CDB_ITER_CONTINUE;
}

static struct k_delayed_work prov_beac_timeout_work;

static void prov_beac_timeout_work_handler(struct k_work *work)
{
	for (int i = 0; i < unprov_devs.number; i++) {
		unprov_devs.dev[i].time++;

		if(unprov_devs.dev[i].time > UNPROV_BEAC_TIMEOUT) {
			for (int j = i; j < unprov_devs.number; j++) {
				unprov_devs.dev[j] = unprov_devs.dev[j + 1];
			}

			unprov_devs.number--;
		}
	}

	k_delayed_work_submit(&prov_beac_timeout_work, K_MSEC(1000));
}

void set_comp_data(const struct bt_mesh_comp comp_data)
{
	gw_comp_data = comp_data;
}

void bt_ready(int err)
{
	if (err) {
		printk("Bluetooth init failed (err %d)\n", err);
		return;
	}

	uint8_t net_key[16], dev_key[16];

	err = bt_mesh_init(&prov, &gw_comp_data);
	if (err) {
		printk("Initializing mesh failed (err %d)\n", err);
		return;
	}

	printk("Mesh initialized\n");

	if (IS_ENABLED(CONFIG_BT_SETTINGS)) {
		printk("Loading stored settings\n");
		settings_load();
	}

	bt_rand(net_key, 16);

	err = bt_mesh_cdb_create(net_key);
	if (err == -EALREADY) {
		printk("Using stored CDB\n");
	} else if (err) {
		printk("Failed to create CDB (err %d)\n", err);
		return;
	} else {
		printk("Created CDB\n");
		setup_cdb();
	}

	bt_rand(dev_key, 16);

	err = bt_mesh_provision(net_key, BT_MESH_NET_PRIMARY, 0, 0, self_addr,
				dev_key);
	if (err == -EALREADY) {
		printk("Using stored settings\n");
	} else if (err) {
		printk("Provisioning failed (err %d)\n", err);
		return;
	} else {
		printk("Provisioning completed\n");
	}

	bt_mesh_cdb_node_foreach(check_unconfigured, NULL);

	k_delayed_work_init(&prov_beac_timeout_work, prov_beac_timeout_work_handler);
	k_delayed_work_submit(&prov_beac_timeout_work, K_NO_WAIT);

	return;
}

int provision_device(uint8_t dev_num, const uint8_t *uuid)
{
	char uuid_hex_str[32 + 1];
	int err;

	if (bt_mesh_prov_link_active()) {
		return -1;
	}

	k_sem_reset(&sem_node_added);

	if (uuid == NULL) {
		bin2hex(unprov_devs.dev[dev_num].uuid, 16, uuid_hex_str, sizeof(uuid_hex_str));

		printk("Provisioning %s\n", uuid_hex_str);

		err = bt_mesh_provision_adv(unprov_devs.dev[dev_num].uuid, net_idx, 0, 0, false);
		if (err < 0) {
			printk("Provisioning failed (err %d)\n", err);
			return err;
		}
	} else {
		bin2hex(uuid, 16, uuid_hex_str, sizeof(uuid_hex_str));

		printk("Provisioning %s\n", uuid_hex_str);
		err = bt_mesh_provision_adv(uuid, net_idx, 0, 0, false);
		if (err < 0) {
			printk("Provisioning failed (err %d)\n", err);
			return err;
		}
	}

	printk("Waiting for node to be added...\n");
	err = k_sem_take(&sem_node_added, K_SECONDS(10));
	if (err == -EAGAIN) {
		printk("Timeout waiting for node to be added\n");
		return err;
	}

	printk("Added node 0x%04x\n", added_node_addr);

	bt_mesh_cdb_node_foreach(check_unconfigured, NULL);

	k_sleep(K_MSEC(3000)); // TODO: Improve this?

	return err;
}

// struct bt_mesh_cdb_node *node = bt_mesh_cdb_node_get(added_node_addr);

int get_model_info(struct model_info *mod_inf)
{
	NET_BUF_SIMPLE_DEFINE(comp, 64);
	uint8_t status;
	int err, i;

	/* Only page 0 is currently implemented */
	err = bt_mesh_cfg_comp_data_get(net_idx, added_node_addr, 0x00,
					&status, &comp);
	if (err) {
		printk("Getting composition failed (err %d)\n", err);
		return err;
	}

	if (status != 0x00) {
		printk("Got non-success status 0x%02x\n", status);
		return status;
	}

	printk("Composition Data for 0x%04x:\n", added_node_addr);
	printk("\tCID      0x%04x\n",
		    net_buf_simple_pull_le16(&comp));
	printk("\tPID      0x%04x\n",
		    net_buf_simple_pull_le16(&comp));
	printk("\tVID      0x%04x\n",
		    net_buf_simple_pull_le16(&comp));
	printk("\tCRPL     0x%04x\n",
		    net_buf_simple_pull_le16(&comp));
	printk("\tFeatures 0x%04x\n",
		    net_buf_simple_pull_le16(&comp));

	while (comp.len > 4) {
		uint8_t sig, vnd;
		uint16_t loc;

		loc = net_buf_simple_pull_le16(&comp);
		sig = net_buf_simple_pull_u8(&comp);
		vnd = net_buf_simple_pull_u8(&comp);

		printk("\tElement @ 0x%04x:\n", loc);

		if (comp.len < ((sig * 2U) + (vnd * 4U))) {
			printk("\t\t...truncated data!\n");
			break;
		}

		if (sig) {
			printk("\t\tSIG Models:\n");
		} else {
			printk("\t\tNo SIG Models\n");
		}

		for (i = 0; i < sig; i++) {
			uint16_t mod_id = net_buf_simple_pull_le16(&comp);

			if (mod_id == BT_MESH_MODEL_ID_GEN_ONOFF_SRV) {
				mod_inf->srv_count++;
			} else if (mod_id == BT_MESH_MODEL_ID_GEN_ONOFF_CLI) {
				mod_inf->cli_count++;
			}

			printk("\t\t\t0x%04x\n", mod_id);
		}

		if (vnd) {
			printk("\t\tVendor Models:\n");
		} else {
			printk("\t\tNo Vendor Models\n");
		}

		for (i = 0; i < vnd; i++) {
			uint16_t cid = net_buf_simple_pull_le16(&comp);
			uint16_t mod_id = net_buf_simple_pull_le16(&comp);

			printk("\t\t\tCompany 0x%04x: 0x%04x\n", cid,
				    mod_id);
		}
	}

	return 0;
}

int configure_server(uint8_t elem_num, uint16_t group_addr)
{
	int err;

	err = bt_mesh_cfg_mod_app_bind(net_idx, added_node_addr, (added_node_addr + elem_num), app_idx, BT_MESH_MODEL_ID_GEN_ONOFF_SRV, NULL);
	if (err) {
		printk("Error binding app key to server (%d)\n", err);
		return err;
	}

	err = bt_mesh_cfg_mod_sub_add(net_idx, added_node_addr, (added_node_addr + elem_num), group_addr, BT_MESH_MODEL_ID_GEN_ONOFF_SRV, NULL);
	if (err) {
		printk("Error setting server subscription address (%d)\n", err);
		return err;
	}

	printk("Server model %d configured\n", elem_num);

	return 0;
}

int configure_client(uint8_t elem_num, uint16_t group_addr)
{
	int err;

	struct bt_mesh_cfg_mod_pub pub_params = {
		.addr = group_addr,
		.app_idx = app_idx,
		.cred_flag = false,
		.ttl = 7,
		.period = 0,
		.transmit = 0,
	};

	err = bt_mesh_cfg_mod_app_bind(net_idx, added_node_addr, (added_node_addr + elem_num), app_idx, BT_MESH_MODEL_ID_GEN_ONOFF_CLI, NULL);
	if (err) {
		printk("Error binding app key to client (%d)\n", err);
		return err;
	}

	err = bt_mesh_cfg_mod_pub_set(net_idx, added_node_addr, (added_node_addr + elem_num), BT_MESH_MODEL_ID_GEN_ONOFF_CLI, &pub_params, NULL);
	if (err) {
		printk("Error setting client publishing parameters (%d)\n", err);
		return err;
	}

	printk("Client model %d configured\n", elem_num);

	return 0;
}

void blink_device(uint8_t dev_num) 
{
	int err;

	err = bt_mesh_provision_adv(unprov_devs.dev[dev_num].uuid, net_idx, 0, 100, true);
	if (err == -16) {
		printk("Provision link still active...\n");
	} else if (err < 0) {
		printk("provision_adv failed (%d)\n", err);
	}
}

uint8_t get_unprov_dev_num(void) 
{
	return unprov_devs.number;
}

bool prov_link_active(void)
{
	return bt_mesh_prov_link_active();
}

uint16_t get_added_node_addr(void) 
{
	return added_node_addr;
}
```
