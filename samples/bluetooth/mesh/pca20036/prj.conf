## CMakeLists.txt
```
#
# Copyright (c) 2021 Nordic Semiconductor ASA
#
# SPDX-License-Identifier: LicenseRef-BSD-5-Clause-Nordic
#
cmake_minimum_required(VERSION 3.8.2)

find_package(Zephyr REQUIRED HINTS $ENV{ZEPHYR_BASE})
project(NONE)

target_sources(app PRIVATE
	src/main.c
	src/pca20036_ethernet.c
	src/ethernet_dfu.c
	src/ethernet_command_system.c
	src/ethernet_logging.c
	src/ethernet_utils.c
	src/hp_led.c
	../../../../../modules/hal/wiznet/Callback/dhcp_cb.c
	../../../../../modules/hal/wiznet/Ethernet/W5500/w5500.c
	../../../../../modules/hal/wiznet/Ethernet/socket.c
	../../../../../modules/hal/wiznet/Ethernet/wizchip_conf.c
	../../../../../modules/hal/wiznet/Internet/DHCP/dhcp.c
	../../../../../modules/hal/wiznet/Internet/TFTP/tftp.c
	../../../../../modules/hal/wiznet/Internet/TFTP/netutil.c)
target_include_directories(app PRIVATE include
	../../../../../modules/hal/wiznet/Callback
	../../../../../modules/hal/wiznet/Ethernet
	../../../../../modules/hal/wiznet/Ethernet/W5500
	../../../../../modules/hal/wiznet/Internet/DHCP
	../../../../../modules/hal/wiznet/Internet/TFTP)
```

## sample.yaml
```
sample:
  name: PCA20036
  description: PCA20036
tests:
  samples.bluetooth.mesh.pca20036:
    build_only: true
    build_on_all: true
    platform_whitelist: pca20036_nrf52840
    tags: bluetooth ci_build
```

## prj.conf
```kconfig
#
# Copyright (c) 2021 Nordic Semiconductor ASA
#
# SPDX-License-Identifier: LicenseRef-BSD-5-Clause-Nordic
#

# Enable Zephyr application to be booted by MCUboot
CONFIG_BOOTLOADER_MCUBOOT=y

# General configuration
CONFIG_MAIN_STACK_SIZE=4096
CONFIG_SYSTEM_WORKQUEUE_STACK_SIZE=4096
CONFIG_FLASH=y
CONFIG_NVS=y
CONFIG_SETTINGS=y
CONFIG_HWINFO=y
CONFIG_ASSERT=y
CONFIG_LOG=y
CONFIG_LOG_PRINTK=y

CONFIG_DK_LIBRARY=y

# WIZnet W5500 SPI
CONFIG_SPI=y
CONFIG_SPI_0=y

# DFU
CONFIG_IMG_MANAGER=y
CONFIG_IMG_ERASE_PROGRESSIVELY=y
CONFIG_DFU_TARGET=y

# Debugging
# CONFIG_DEBUG=y
# CONFIG_LOG_BUFFER_SIZE=16000
# CONFIG_SEGGER_RTT_BUFFER_SIZE_UP=4096
```

## src/main.c
```c
/*
 * Copyright (c) 2021 Nordic Semiconductor ASA
 *
 * SPDX-License-Identifier: LicenseRef-BSD-5-Clause-Nordic
 */

#include <zephyr.h>
#include <dk_buttons_and_leds.h>
#include "pca20036_ethernet.h"
#include "ethernet_command_system.h"
#include "ethernet_dfu.h"
#include "hp_led.h"

static struct k_delayed_work ethernet_rx_work;

static void button_handler(uint32_t button_state, uint32_t has_changed)
{
	static bool onoff = true;

	if (button_state & BIT(0)) {
		printk("Button 0 pressed\n");
		onoff = !onoff;
	}
}

static void ethernet_rx_work_handler(struct k_work *work)
{
	ethernet_command_system_rx();
	k_delayed_work_submit(&ethernet_rx_work, K_MSEC(10));
}

static void ethernet_rx_work_init_start(void)
{
	k_delayed_work_init(&ethernet_rx_work, ethernet_rx_work_handler);
	k_delayed_work_submit(&ethernet_rx_work, K_NO_WAIT);
}

void main(void)
{
	int err;

	printk("- PCA20036 sample -\n");
	printk("- Version: %d -\n", DFU_APP_VERSION);

	err = hp_led_init();

	if (err) {
		printk("Error initializing HP LED\n");
		return;
	}

	err = dk_buttons_init(button_handler);

	if (err) {
		printk("Error initializing buttons\n");
		return;
	}

	err = pca20036_ethernet_init();

	if (err) {
		printk("Error initializing buttons\n");
		return;
	}

	ethernet_rx_work_init_start();

	printk("- Initiated -\n");

	/* DHCP may not be leased yet - check flag */
}
```

## include/ethernet_command_system.h
```c
/*
 * Copyright (c) 2021 Nordic Semiconductor ASA
 *
 * SPDX-License-Identifier: LicenseRef-BSD-5-Clause-Nordic
 */

#ifndef ETHERNET_COMMAND_SYSTEM_H
#define ETHERNET_COMMAND_SYSTEM_H

#include <stdio.h>
#include <stdint.h>
#include <stdbool.h>
#include <string.h>

enum ethernet_ctrl_cmd {
	CMD_RESET = 0x01,
	CMD_I_AM_ALIVE = 0x02,
	CMD_DFU = 0x03,
	CMD_LED = 0x04,
};

struct __attribute((packed)) ethernet_reset_package {
	bool is_broadcast;
	uint8_t target_mac[6];
};

struct __attribute((packed)) ethernet_i_am_alive_package {
	uint8_t ip[4];
	uint8_t mac[6];
	uint8_t version;
};

struct __attribute((packed)) ethernet_dfu_package {
	bool is_broadcast;
	uint8_t target_mac[6];
};

struct __attribute((packed)) ethernet_led_package {
	bool is_broadcast;
	bool on_off;
	uint8_t target_mac[6];
};

struct __attribute((packed)) command_system_package {
	uint32_t identifier;
	uint8_t opcode;
	uint8_t mac[6];
	union {
		struct ethernet_reset_package reset_package;
		struct ethernet_i_am_alive_package i_am_alive_package;
		struct ethernet_dfu_package dfu_package;
		struct ethernet_led_package led_package;
	} payload;
};

void ethernet_command_system_rx(void);

void send_over_ethernet(uint8_t *payload_package, uint8_t opcode);

void ethernet_command_system_init(void);

#endif // ETHERNET_COMMAND_SYSTEM_H
```

## include/ethernet_dfu.h
```c
/*
 * Copyright (c) 2021 Nordic Semiconductor ASA
 *
 * SPDX-License-Identifier: LicenseRef-BSD-5-Clause-Nordic
 */

#ifndef ETHERNET_DFU_H
#define ETHERNET_DFU_H

#include <stdio.h>
#include <stdint.h>
#include <stdbool.h>
#include <stdlib.h>
#include <string.h>

#define DFU_APP_VERSION 1

void ethernet_dfu_start(uint8_t *server_ip);

void ethernet_dfu_confirm_image(void);

void ethernet_dfu_init(void);

#endif // ETHERNET_DFU_H
```

## include/ethernet_logging.h
```c
/*
 * Copyright (c) 2021 Nordic Semiconductor ASA
 *
 * SPDX-License-Identifier: LicenseRef-BSD-5-Clause-Nordic
 */

#ifndef ETHERNET_LOGGING_H
#define ETHERNET_LOGGING_H

#define ETHERNET_LOGGING_THREAD_STACKSIZE 1024

enum ext_log_level {
	EXT_LOG_CRITICAL,
	EXT_LOG_ERROR,
	EXT_LOG_WARNING,
	EXT_LOG_NOTICE,
	EXT_LOG_INFO,
	EXT_LOG_DEBUG
};

typedef void (*ext_log_handler)(enum ext_log_level level, const char *format,
				...);

#define ext_log(level, ...) log_handler(level, __VA_ARGS__)

#endif // ETHERNET_LOGGING_H
```

## include/ethernet_utils.h
```c
/*
 * Copyright (c) 2021 Nordic Semiconductor ASA
 *
 * SPDX-License-Identifier: LicenseRef-BSD-5-Clause-Nordic
 */

#ifndef ETHERNET_UTILS_H
#define ETHERNET_UTILS_H

#include <stdio.h>
#include <stdint.h>
#include <stdbool.h>
#include <stdlib.h>
#include <string.h>

bool arrays_are_equal(uint8_t *p_arr1, uint8_t *p_arr2, uint8_t n, uint8_t m);

bool mac_addresses_are_equal(uint8_t *ip1, uint8_t *ip2);

bool ip_addresses_are_equal(uint8_t *ip1, uint8_t *ip2);

#endif // ETHERNET_UTILS_H
```

## include/hp_led.h
```c
/*
 * Copyright (c) 2021 Nordic Semiconductor ASA
 *
 * SPDX-License-Identifier: LicenseRef-BSD-5-Clause-Nordic
 */

#ifndef HP_LED_H
#define HP_LED_H

#include <stdio.h>
#include <stdint.h>
#include <stdbool.h>
#include <stdlib.h>
#include <string.h>

#define HP_LED_PIN 13

void hp_led_on(void);

void hp_led_off(void);

bool hp_led_get_state(void);

int hp_led_init(void);

#endif // HP_LED_H
```

## include/model_handler.h
```c
/*
 * Copyright (c) 2021 Nordic Semiconductor ASA
 *
 * SPDX-License-Identifier: LicenseRef-Nordic-5-Clause
 */

#ifndef MODEL_HANDLER_H__
#define MODEL_HANDLER_H__

#include <bluetooth/mesh.h>

const struct bt_mesh_comp *model_handler_init(void);

#endif /* MODEL_HANDLER_H__ */
```

## include/pca20036_ethernet.h
```c
/*
 * Copyright (c) 2021 Nordic Semiconductor ASA
 *
 * SPDX-License-Identifier: LicenseRef-BSD-5-Clause-Nordic
 */

#ifndef PCA20036_ETHERNET_H
#define PCA20036_ETHERNET_H

#define SOCKET_DHCP 2
#define SOCKET_TFTP 3
#define SOCKET_TX 4
#define SOCKET_RX 5

#define TX_IP ((const uint8_t[]){ 255, 255, 255, 255 })
#define RX_PORT 10000
#define TX_PORT 10001
#define TX_FLAGS 0x00
#define TX_BUF_SIZE 2048

void get_own_ip(uint8_t *p_ip);

void get_own_mac(uint8_t *p_mac);

bool get_dhcp_leased_flag(void);

int pca20036_ethernet_init(void);

#endif // PCA20036_ETHERNET_H
```

## src/ethernet_command_system.c
```c
/*
 * Copyright (c) 2021 Nordic Semiconductor ASA
 *
 * SPDX-License-Identifier: LicenseRef-BSD-5-Clause-Nordic
 */

#include <zephyr.h>

#include "ethernet_command_system.h"
#include "pca20036_ethernet.h"
#include "w5500.h"
#include "socket.h"
#include "ethernet_utils.h"
#include "hp_led.h"
#include "ethernet_dfu.h"

static struct k_delayed_work i_am_alive_work;

static uint8_t received_data[200];
static struct command_system_package received_package;

static uint16_t cmd_rx_port = RX_PORT;
static uint8_t own_mac[6];
static uint8_t own_ip[4];
static uint8_t server_ip[4];

static void i_am_alive_work_handler(struct k_work *work)
{
	struct ethernet_i_am_alive_package i_am_alive_package;

	get_own_ip((uint8_t *)&i_am_alive_package.ip);
	get_own_mac((uint8_t *)&i_am_alive_package.mac);
	i_am_alive_package.version = DFU_APP_VERSION;

	send_over_ethernet((uint8_t *)&i_am_alive_package, CMD_I_AM_ALIVE);

	k_delayed_work_submit(&i_am_alive_work, K_MSEC(5000));
}

static void i_am_alive_work_init_start(void)
{
	k_delayed_work_init(&i_am_alive_work, i_am_alive_work_handler);
	k_delayed_work_submit(&i_am_alive_work, K_NO_WAIT);
}

void ethernet_command_system_rx(void)
{
	while (getSn_RX_RSR(SOCKET_RX) != 0x00) {
		get_own_ip(own_ip);

		int32_t recv_len = recvfrom(SOCKET_RX, received_data,
					    sizeof(received_data), server_ip,
					    &cmd_rx_port);

		if (recv_len >= 4) // 4 because of the first memcpy
		{
			uint32_t identifier;
			memcpy(&identifier, received_data, 4);

			if (identifier == 0xDEADFACE) {
				memcpy(&received_package, received_data,
				       sizeof(received_package));

				switch (received_package.opcode) {
				case CMD_RESET:
					if (received_package.payload
						    .reset_package
						    .is_broadcast ||
					    mac_addresses_are_equal(
						    own_mac,
						    received_package.payload
							    .reset_package
							    .target_mac)) {
						printk("CMD: Reset node\n");
						NVIC_SystemReset();
					}
					break;
				case CMD_DFU:
					if (received_package.payload.dfu_package
						    .is_broadcast ||
					    mac_addresses_are_equal(
						    own_mac,
						    received_package.payload
							    .dfu_package
							    .target_mac)) {
						ethernet_dfu_start(server_ip);
					}
					break;
				case CMD_LED:
					if (received_package.payload.led_package
						    .is_broadcast ||
					    mac_addresses_are_equal(
						    own_mac,
						    received_package.payload
							    .led_package
							    .target_mac)) {
						if (received_package.payload
							    .led_package
							    .on_off) {
							printk("CMD: HP LED ON\n");
							hp_led_on();
						} else {
							printk("CMD: HP LED OFF\n");
							hp_led_off();
						}
					}
					break;
				default:
					printk("CMD: Unrecognized control command: %d\n",
					       received_package.opcode);
					break;
				}
			}
		}
	}
}

void send_over_ethernet(uint8_t *payload_package, uint8_t opcode)
{
	struct command_system_package package;
	package.identifier = 0xDEADFACE;
	package.opcode = opcode;
	get_own_mac((uint8_t *)&package.mac);

	bool send_package = true;

	switch (opcode) {
	case CMD_I_AM_ALIVE: {
		struct ethernet_i_am_alive_package i_am_alive_package;
		memcpy(&i_am_alive_package, payload_package,
		       sizeof(struct ethernet_i_am_alive_package));
		package.payload.i_am_alive_package = i_am_alive_package;
		break;
	}
	default:
		printk("send_over_ethernet: Unknown package type chosen\n");
		send_package = false;
		break;
	}

	if (send_package) {
		int32_t err = sendto(SOCKET_TX, (uint8_t *)&package,
				     sizeof(struct command_system_package),
				     (uint8_t *)TX_IP, TX_PORT);

		if (err < 0) {
			printk("Error sending packet - error code: %d\n", err);
		}
	}
}

void ethernet_command_system_init(void)
{
	get_own_mac(own_mac);
	i_am_alive_work_init_start();
}
```

## src/ethernet_dfu.c
```c
/*
 * Copyright (c) 2021 Nordic Semiconductor ASA
 *
 * SPDX-License-Identifier: LicenseRef-BSD-5-Clause-Nordic
 */

#include <zephyr.h>
#include <string.h>
#include <drivers/flash.h>
#include <storage/flash_map.h>
#include <dfu/mcuboot.h>

#include "pca20036_ethernet.h"
#include "w5500.h"
#include "socket.h"
#include "tftp.h"
#include "hp_led.h"

#define FLASH_BLOCK_SIZE 512
#define FLASH_PAGE_SIZE 4096
#define FLASH_IMG_1_OFFSET FLASH_AREA_OFFSET(image_1)
#define FLASH_IMG_1_SIZE FLASH_AREA_SIZE(image_1)
#define FLASH_IMG_1_LAST_PAGE_ADDR                                             \
	(FLASH_IMG_1_OFFSET + FLASH_IMG_1_SIZE - FLASH_PAGE_SIZE)

static const struct device *flash_dev;

static struct k_delayed_work led_blinking_work;
static struct k_delayed_work tftp_work;

static uint8_t tftp_rcv_buf[MAX_MTU_SIZE];

static uint32_t bytes_written = 0;
static bool save_data_successful = true;

static void led_blinking_work_handler(struct k_work *work)
{
	static bool led_on = false;

	if (led_on) {
		hp_led_off();
		led_on = false;
	} else {
		hp_led_on();
		led_on = true;
	}

	k_delayed_work_submit(&led_blinking_work, K_MSEC(1000));
}

static void led_blinking_work_init(void)
{
	k_delayed_work_init(&led_blinking_work, led_blinking_work_handler);
}

static void led_blinking_work_start(void)
{
	k_delayed_work_submit(&led_blinking_work, K_NO_WAIT);
}

static void led_blinking_work_stop(void)
{
	k_delayed_work_cancel(&led_blinking_work);
}

static void tftp_work_handler(struct k_work *work)
{
	static uint8_t tick = 0;
	uint32_t ret;
	int err;

	ret = TFTP_run();

	if (ret == TFTP_PROGRESS) {
		if (tick < 100) {
			tick++;
		} else {
			tftp_timeout_handler();
			tick = 0;
		}

		k_delayed_work_submit(&tftp_work, K_MSEC(10));
	} else {
		if (ret == 2 && save_data_successful == true) {
			printk("TFTP finished successfully\n");

			led_blinking_work_stop();
			hp_led_off();

			err = boot_request_upgrade(BOOT_UPGRADE_TEST);

			if (err) {
				printk("Error requesting firmware upgrade\n");
			} else {
				NVIC_SystemReset();
			}
		} else {
			printk("TFTP DFU operation failed\n");
			led_blinking_work_stop();
			hp_led_off();
			tick = 0;
		}
	}
}

static void tftp_work_init_start(void)
{
	k_delayed_work_init(&tftp_work, tftp_work_handler);
	k_delayed_work_submit(&tftp_work, K_MSEC(10));

	printk("TFTP transfer started\n");
}

static void flash_init(void)
{
	flash_dev = device_get_binding(
		DT_PROP(DT_NODELABEL(flash_controller), label));

	if (!flash_dev) {
		printk("Flash init: Error getting device\n");
	} else {
		printk("Flash initiated\n");
	}
}

extern void save_data(uint8_t *data, uint32_t data_len, uint16_t block_number)
{
	static uint8_t block_counter = 0;
	static uint16_t page_counter = 0;
	int err;

	// printk("TFTP block_number: %d - data_len: %d\n", block_number,
	//        data_len);

	if (block_number == 0) {
		block_counter = 0;
		page_counter = 0;
		bytes_written = 0;
	}

	err = flash_write_protection_set(flash_dev, false);
	if (err) {
		printk("Error removing flash write protection\n");
		save_data_successful = false;
		return;
	}

	if (data_len == FLASH_BLOCK_SIZE) {
		err = flash_write(flash_dev,
				  FLASH_IMG_1_OFFSET +
					  (page_counter * FLASH_PAGE_SIZE) +
					  (block_counter * FLASH_BLOCK_SIZE),
				  data, FLASH_BLOCK_SIZE);
		if (err) {
			printk("Error writing to flash (%d)\n", err);
			save_data_successful = false;
			return;
		}
	} else if (data_len < FLASH_BLOCK_SIZE) {
		uint8_t buf[FLASH_BLOCK_SIZE] = { 0xFF };

		memcpy(buf, data, data_len);

		err = flash_write(flash_dev,
				  FLASH_IMG_1_OFFSET +
					  (page_counter * FLASH_PAGE_SIZE) +
					  (block_counter * FLASH_BLOCK_SIZE),
				  buf, FLASH_BLOCK_SIZE);
		if (err) {
			printk("Error writing to flash (%d)\n", err);
			save_data_successful = false;
			return;
		}
	} else {
		printk("TFTP data length longer than block size\n");
		save_data_successful = false;
		return;
	}

	if (block_counter >= 7) {
		block_counter = 0;
		page_counter++;
	} else {
		block_counter++;
	}

	flash_write_protection_set(flash_dev, true);
	if (err) {
		printk("Error setting flash write protection\n");
		save_data_successful = false;
	}

	bytes_written += data_len;

	printk("Bytes written: %d\n", bytes_written);
}

/******* Interface functions *******/

void ethernet_dfu_start(uint8_t *server_ip)
{
	int err;

	if (get_dhcp_leased_flag()) {
		uint32_t tftp_server;
		uint8_t *filename;

		printk("Starting DFU\n");

		led_blinking_work_start();

		// Allowing the logging to output messages before the erasing starts
		k_sleep(K_MSEC(3000));

		err = flash_erase(flash_dev, FLASH_IMG_1_OFFSET,
				  FLASH_IMG_1_SIZE);
		if (err) {
			printk("Error erasing image 1 flash partition (%d)\n",
			       err);
		}

		TFTP_init(SOCKET_TFTP, tftp_rcv_buf);

		tftp_server = (*(server_ip) << 24) | (*(server_ip + 1) << 16) |
			      (*(server_ip + 2) << 8) | (*(server_ip + 3));
		filename = (uint8_t *)"app_update.bin";

		TFTP_read_request(tftp_server, filename);

		tftp_work_init_start();
	} else {
		printk("Ethernet not initiated - Can not start DFU\n");
	}
}

void ethernet_dfu_confirm_image(void)
{
	boot_write_img_confirmed();
}

void ethernet_dfu_init(void)
{
	flash_init();
	led_blinking_work_init();
}
```

## src/ethernet_logging.c
```c
#include <zephyr.h>
#include <string.h>
// #include <sys/printk.h>
#include <logging/log_ctrl.h>
#include <logging/log.h>
#include <app_memory/app_memdomain.h>
#include "ethernet_logging.h"

LOG_MODULE_REGISTER(ethernet_log_system);

static const uint8_t log_level_lut[] = {
	LOG_LEVEL_ERR, /* EXT_LOG_CRITICAL */
	LOG_LEVEL_ERR, /* EXT_LOG_ERROR */
	LOG_LEVEL_WRN, /* EXT_LOG_WARNING */
	LOG_LEVEL_INF, /* EXT_LOG_NOTICE */
	LOG_LEVEL_INF, /* EXT_LOG_INFO */
	LOG_LEVEL_DBG /* EXT_LOG_DEBUG */
};

static void ethernet_log_handler(enum ext_log_level level, const char *fmt, ...)
{
	struct log_msg_ids src_level = { .level = log_level_lut[level],
					 .domain_id = CONFIG_LOG_DOMAIN_ID,
					 .source_id = LOG_CURRENT_MODULE_ID() };

	va_list ap;

	va_start(ap, fmt);
	log_generic(src_level, fmt, ap, LOG_STRDUP_CHECK_EXEC);
	va_end(ap);
}

K_APP_BMEM(app_part) static ext_log_handler log_handler;

static uint32_t timestamp_get(void)
{
	return NRF_RTC1->COUNTER;
}

static uint32_t timestamp_freq(void)
{
	return 32768 / (NRF_RTC1->PRESCALER + 1);
}

static void log_ethernet_thread(void *p1, void *p2, void *p3)
{
	bool usermode = _is_user_context();

	k_sleep(K_MSEC(100));

	printk("\n\t---=< RUNNING ETHERNET LOGGER FROM %s THREAD >=---\n\n",
	       (usermode) ? "USER" : "KERNEL");


    log_handler = ethernet_log_handler;
	// ext_log_system_log_adapt();
	// ext_log_system_foo();

	wait_on_log_flushed();
}

static void log_ethernet_supervisor(void *p1, void *p2, void *p3)
{
	(void)log_set_timestamp_func(timestamp_get, timestamp_freq());

	log_ethernet_thread(p1, p2, p3);
}

K_THREAD_DEFINE(log_ethernet_thread_id, ETHERNET_LOGGING_THREAD_STACKSIZE,
		log_ethernet_supervisor, NULL, NULL, NULL,
		K_LOWEST_APPLICATION_THREAD_PRIO, 0, 1);
```

## src/ethernet_utils.c
```c
/*
 * Copyright (c) 2021 Nordic Semiconductor ASA
 *
 * SPDX-License-Identifier: LicenseRef-BSD-5-Clause-Nordic
 */

#include "ethernet_utils.h"

/* Returns true if arr1[0..n-1] and arr2[0..m-1] contain same elements */
bool arrays_are_equal(uint8_t *p_arr1, uint8_t *p_arr2, uint8_t n, uint8_t m)
{
	if (n != m)
		return false;

	for (uint8_t i = 0; i < n; i++)
		if (p_arr1[i] != p_arr2[i])
			return false;

	return true;
}

bool mac_addresses_are_equal(uint8_t *ip1, uint8_t *ip2)
{
	return arrays_are_equal(ip1, ip2, 6, 6);
}

bool ip_addresses_are_equal(uint8_t *ip1, uint8_t *ip2)
{
	return arrays_are_equal(ip1, ip2, 4, 4);
}
```

## src/hp_led.c
```c
/*
 * Copyright (c) 2021 Nordic Semiconductor ASA
 *
 * SPDX-License-Identifier: LicenseRef-BSD-5-Clause-Nordic
 */

#include <zephyr.h>
#include <drivers/gpio.h>
#include "hp_led.h"

static const struct device *gpio_0;

static bool hp_led_state = false;

void hp_led_on(void)
{
	gpio_pin_set_raw(gpio_0, HP_LED_PIN, 1);
	hp_led_state = true;
}

void hp_led_off(void)
{
	gpio_pin_set_raw(gpio_0, HP_LED_PIN, 0);
	hp_led_state = false;
}

bool hp_led_get_state(void)
{
	return hp_led_state;
}

int hp_led_init(void)
{
	int err;

	gpio_0 = device_get_binding(DT_PROP(DT_NODELABEL(gpio0), label));

	if (gpio_0 == NULL) {
		return -ENODEV;
	}

	err = gpio_pin_configure(gpio_0, HP_LED_PIN, GPIO_OUTPUT);

	return err;
}
```
