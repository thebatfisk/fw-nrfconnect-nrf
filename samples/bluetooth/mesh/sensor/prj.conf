## sample.yaml
```
sample:
  name: Bluetooth Mesh Sensor
  description: Bluetooth Mesh Sensor sample
tests:
  test_build:
    build_only: true
    build_on_all: true
    platform_whitelist: nrf51_pca10028 nrf52_pca10040 nrf52840_pca10056 nrf5340_dk_nrf5340_cpuapp
    tags: bluetooth ci_build
```

## prj.conf
```kconfig
#
# Copyright (c) 2019 Nordic Semiconductor ASA
#
# SPDX-License-Identifier: LicenseRef-BSD-5-Clause-Nordic
#
CONFIG_NCS_SAMPLES_DEFAULTS=y

# General configuration
CONFIG_SYSTEM_WORKQUEUE_STACK_SIZE=2048
CONFIG_FLASH=y
CONFIG_FLASH_MAP=y
CONFIG_FCB=y
CONFIG_SETTINGS=y
CONFIG_HWINFO=y
CONFIG_LOG=y
CONFIG_LOG_PRINTK=y

CONFIG_DK_LIBRARY=y
CONFIG_BT_MESH_DK_PROV=y

# Temperature sensor
CONFIG_SENSOR=y
CONFIG_TEMP_NRF5=y

# Bluetooth configuration
CONFIG_BT=y
CONFIG_BT_COMPANY_ID=0x0059
CONFIG_BT_DEVICE_NAME="Mesh Sensor"
CONFIG_BT_L2CAP_TX_MTU=69
CONFIG_BT_L2CAP_TX_BUF_COUNT=8
CONFIG_BT_LL_SW_SPLIT=y
CONFIG_BT_OBSERVER=y
CONFIG_BT_PERIPHERAL=y
CONFIG_BT_SETTINGS=y

# Disable unused Bluetooth features
CONFIG_BT_CTLR_DUP_FILTER_LEN=0
CONFIG_BT_CTLR_LE_ENC=n
CONFIG_BT_DATA_LEN_UPDATE=n
CONFIG_BT_PHY_UPDATE=n
CONFIG_BT_CTLR_CHAN_SEL_2=n
CONFIG_BT_CTLR_MIN_USED_CHAN=n
CONFIG_BT_CTLR_PRIVACY=n

# Bluetooth Mesh configuration
CONFIG_BT_MESH=y
CONFIG_BT_MESH_RELAY=y
CONFIG_BT_MESH_FRIEND=y
CONFIG_BT_MESH_ADV_BUF_COUNT=13
CONFIG_BT_MESH_TX_SEG_MAX=10
CONFIG_BT_MESH_PB_GATT=y
CONFIG_BT_MESH_GATT_PROXY=y

# Bluetooth Mesh models
CONFIG_BT_MESH_ONOFF_SRV=y
```

## src/main.c
```c
/*
 * Copyright (c) 2019 Nordic Semiconductor ASA
 *
 * SPDX-License-Identifier: LicenseRef-BSD-5-Clause-Nordic
 */

/** @file
 *  @brief Nordic Mesh light sample
 */
// #include <zephyr.h>
#include <bluetooth/bluetooth.h>
#include <bluetooth/mesh/models.h>
#include <bluetooth/mesh/dk_prov.h>
#include <dk_buttons_and_leds.h>
#include "model_handler.h"

static struct sensor_value sensor_val;
static struct device *dev;

void my_work_handler(struct k_work *work)
{
    sensor_sample_fetch(dev);
	sensor_channel_get(dev, SENSOR_CHAN_DIE_TEMP, &sensor_val);

	printk("*** Sensor value: %d.%02d ***\n", sensor_val.val1, sensor_val.val2);
}

K_WORK_DEFINE(my_work, my_work_handler);

void my_timer_handler(struct k_timer *dummy)
{
	k_work_submit(&my_work);
}

K_TIMER_DEFINE(my_timer, my_timer_handler, NULL);

void button_handler(u32_t button_state, u32_t has_changed)
{
	u32_t button = button_state & has_changed;

	if (button & DK_BTN1_MSK) 
	{
	k_work_submit(&my_work);
	}
	
}

void main(void)
{
	// int err;

	dk_leds_init();
	dk_buttons_init(button_handler);

	// *** Sensor

	dev = device_get_binding(DT_INST_0_NORDIC_NRF_TEMP_LABEL);

	if (dev == NULL) {
		printk("Could not get device\n");
	}

	printk("*** Sensor reading test - Device: %s ***\n", dev->config->name);

	// *** Timer
	
	/* start periodic timer that expires once every second */
	k_timer_start(&my_timer, K_SECONDS(1), K_SECONDS(5));
	
	// *** Mesh ***
	
	// err = bt_enable(NULL);
	// if (err) {
	// 	printk("Bluetooth init failed (err %d)\n", err);
	// 	return;
	// }

	// err = bt_mesh_init(bt_mesh_dk_prov_init(), model_handler_init());
	// if (err) {
	// 	printk("Initializing mesh failed (err %d)\n", err);
	// 	return;
	// }

	// if (IS_ENABLED(CONFIG_SETTINGS)) {
	// 	settings_load(); // "DSM"
	// }

	// /* This will be a no-op if settings_load() loaded provisioning info */
	// bt_mesh_prov_enable(BT_MESH_PROV_ADV | BT_MESH_PROV_GATT);

	// printk("Mesh initialized\n");

	// ************

	while (true) {
		
	}
}
```

## src/model_handler.c
```c
/*
 * Copyright (c) 2019 Nordic Semiconductor ASA
 *
 * SPDX-License-Identifier: LicenseRef-BSD-5-Clause-Nordic
 */

#include <bluetooth/bluetooth.h>
#include <bluetooth/mesh/models.h>
#include <dk_buttons_and_leds.h>
#include "model_handler.h"

// extern struct bt_mesh_sensor temperature_sensor;
// extern struct bt_mesh_sensor motion_sensor;
// extern struct bt_mesh_sensor light_sensor;

static struct device *dev;

static int temp_get(struct bt_mesh_sensor *sensor,
                    struct bt_mesh_msg_ctx *ctx,
                    struct sensor_value *rsp)
{
    sensor_sample_fetch(dev);
    return sensor_channel_get(dev, SENSOR_CHAN_DIE_TEMP, rsp);
}

struct bt_mesh_sensor temperature_sensor = {
    .type = &bt_mesh_sensor_present_dev_op_temp,
    .get = temp_get,
};

static struct bt_mesh_sensor* const sensors[] = {
    &temperature_sensor,
    // &motion_sensor,
    // &light_sensor,
};

static struct bt_mesh_sensor_srv sensor_srv = BT_MESH_SENSOR_SRV_INIT(sensors, ARRAY_SIZE(sensors));

/** Configuration server definition */
static struct bt_mesh_cfg_srv cfg_srv = { // *** Configuration server definition
	.relay = IS_ENABLED(CONFIG_BT_MESH_RELAY),
	.beacon = BT_MESH_BEACON_ENABLED,
	.frnd = IS_ENABLED(CONFIG_BT_MESH_FRIEND),
	.gatt_proxy = IS_ENABLED(CONFIG_BT_MESH_GATT_PROXY),
	.default_ttl = 7,

	/* 3 transmissions with 20ms interval */
	.net_transmit = BT_MESH_TRANSMIT(2, 20),
	.relay_retransmit = BT_MESH_TRANSMIT(2, 20),
};

/* Set up a repeating delayed work to blink the DK's LEDs when attention is
 * requested.
 */
static struct k_delayed_work attention_blink_work; // *** The delayed work context?

static void attention_blink(struct k_work *work) // *** The attention blink *handler* function used by the kernel delayed work
{
	static int idx;
	const u8_t pattern[] = {
		BIT(0) | BIT(1),
		BIT(1) | BIT(2),
		BIT(2) | BIT(3),
		BIT(3) | BIT(0),
	};
	dk_set_leds(pattern[idx++ % ARRAY_SIZE(pattern)]);
	k_delayed_work_submit(&attention_blink_work, K_MSEC(30));
}

static void attention_on(struct bt_mesh_model *mod) // *** Attention blinking *used by health server*
{
	k_delayed_work_submit(&attention_blink_work, K_NO_WAIT);
}

static void attention_off(struct bt_mesh_model *mod) // *** Attention blinking *used by health server*
{
	k_delayed_work_cancel(&attention_blink_work);
	dk_set_leds(DK_NO_LEDS_MSK);
}

static const struct bt_mesh_health_srv_cb health_srv_cb = { // *** Healt server callback - defined in health server model context
	.attn_on = attention_on,
	.attn_off = attention_off,
};

static struct bt_mesh_health_srv health_srv = { // *** Health server model context
	.cb = &health_srv_cb,
};

BT_MESH_HEALTH_PUB_DEFINE(health_pub, 0); // *** Health model boiler plate?

static struct bt_mesh_elem elements[] = { // *** The mesh elements of the node
	BT_MESH_ELEM(
		1, BT_MESH_MODEL_LIST(
			BT_MESH_MODEL_CFG_SRV(&cfg_srv),
			BT_MESH_MODEL_HEALTH_SRV(&health_srv, &health_pub),
			BT_MESH_MODEL_SENSOR_SRV(&sensor_srv)),
		BT_MESH_MODEL_NONE),
};

static const struct bt_mesh_comp comp = { // *** The composition data used by bt_mesh_init()
	.cid = CONFIG_BT_COMPANY_ID,
	.elem = elements,
	.elem_count = ARRAY_SIZE(elements),
};

const struct bt_mesh_comp *model_handler_init(void) // *** Returns the composition data to bt_mesh_init() after initiating the attention blink delayed work
{
	k_delayed_work_init(&attention_blink_work, attention_blink);

	dev = device_get_binding(DT_INST_0_NORDIC_NRF_TEMP_LABEL);

	if (dev == NULL) {
		printk("Could not get device\n");
		return;
	}

	printk("*** Sensor reading test - Device: %s ***\n", dev->config->name);

	return &comp;
}
```
